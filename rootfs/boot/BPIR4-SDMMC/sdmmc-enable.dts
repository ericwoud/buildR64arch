/dts-v1/;
/plugin/;

#define GPIO_ACTIVE_LOW 1

&mmc0 {
  pinctrl-names = "default", "state_uhs";
  pinctrl-0 = <&mmc0_pins_sdcard>;
  pinctrl-1 = <&mmc0_pins_sdcard>;
  cd-gpios = <&pio 12 GPIO_ACTIVE_LOW>;
  bus-width = <4>;
  max-frequency = <52000000>;
  cap-sd-highspeed;
  vmmc-supply = <&reg_3p3v>;
  vqmmc-supply = <&reg_3p3v>;
//  no-mmc;
  status = "okay";
};
